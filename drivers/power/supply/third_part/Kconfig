## drivers/power/supply/third_part/Kconfig
```kconfig
# SPDX-License-Identifier: GPL-2.0-only
menuconfig THIRD_PART_POWER_SUPPLY
	bool "Support for Third Part Inc. power supply"
	depends on ARCH_QCOM

if THIRD_PART_POWER_SUPPLY

source "drivers/power/supply/third_part/sm5602/Kconfig"

source "drivers/power/supply/third_part/charger_manager/Kconfig"

endif
```

## drivers/power/supply/third_part/charger_manager/Kconfig
```kconfig
config CHINOE_CHARGER
	tristate "Chino-e Charging Driver"
	depends on THIRD_PART_POWER_SUPPLY
	help
	  Say yes here to enable chino-e charging driver.
	  This driver contains charging control flow and
	  maintains charging status.
	  Say no if not using chino-e charging driver.

config CHINOE_MAIN_CHARGER
	tristate "Charger Driver for Chinoe Main Charger IC"
	depends on CHINOE_CHARGER
	help
	  Say Y to enable
	  Chinoe Main Charger driver.
	  It depends on
	  the config CHINOE_CHARGER.

config CHINOE_SLAVE_CHARGER
	tristate "Charger Driver for Chinoe Slave Charger IC"
	depends on CHINOE_CHARGER
	help
	  Say Y to enable
	  Chinoe Slave Charger driver.
	  It depends on
	  the config CHINOE_CHARGER.
```

## drivers/power/supply/third_part/sm5602/Kconfig
```kconfig
#
# TypeC Port Controller Device Configuration
#

config SUPPORT_FUEL_GAUGE_SM5602
	tristate "Support Fuel Gauge SM5602"
	depends on THIRD_PART_POWER_SUPPLY
	default n
	help
	  Say Y to enable
	  Fuel Gauge
	  SM5602 Device Driver
```

## drivers/soc/hmd/Kconfig
```kconfig
# SPDX-License-Identifier: GPL-2.0-only
#
# HMD Soc drivers
#
menu "HMD SoC drivers"

config HMD_SWAPPINESS_OPT
	tristate "swappiness optimization"
	default m
	help
	  define this config to add swappiness optimization feature

config HMD_BOOTMSG
	tristate "Capature first 60s kernel log"
	default m
	help
	  file node:/proc/bootmsg.

config SUPPORT_CRASH_REASON
	tristate "HMD ramdump mode display"
	default m
	help
	  get crash reason

config DEBUG_BOOTLOADER_LOG
        tristate "support the CONFIG_DEBUG_BOOTLOADER_LOG to get the bootloader log with log tool"
        default m
        help
          get the bootloader log with log tool
          
config DUMP_TASKS_MEM
	tristate "dump task memory info"
	default m
	help
	  define this config to add dump task meminfo feature

endmenu
```

## drivers/usb/typec/sgm7220/Kconfig
```kconfig
config TCPC_SGM7220
	tristate "SGMicro SGM7220 TypeC port Controller Driver"
	default n
	help
	  Say Y to enable
	  SGMicro SGM7220
	  TypeC port Controller
	  Driver
```

## drivers/usb/typec/wusb3801x/Kconfig
```kconfig
config TCPC_WUSB3801X
	tristate "WillSemi WUSB3801X TypeC port Controller Driver"
	default n
	help
	  Say Y to enable
	  WillSemi WUSB3801X
	  TypeC port Controller
	  Driver
```
